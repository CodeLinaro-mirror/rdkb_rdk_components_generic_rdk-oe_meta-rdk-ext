## conf/layer.conf
```bitbake
BBPATH .= ":${LAYERDIR}"

BBFILES += "\
            ${LAYERDIR}/recipes-*/*/*.bb \
            ${@bb.utils.contains('DISTRO_FEATURES', 'gstreamer1_18',' ${LAYERDIR}/recipes-*/*/*/*.bb ${LAYERDIR}/recipes-*/*/*/*.bbappend ','',d)} \
            ${LAYERDIR}/recipes-*/*/*.bbappend \
           "

BBFILE_COLLECTIONS += "rdk-ext"
BBFILE_PATTERN_rdk-ext := "^${LAYERDIR}/"
BBFILE_PRIORITY_rdk-ext = "6"

LAYERSERIES_COMPAT_rdk-ext = "zeus dunfell kirkstone"

LAYERDEPENDS_rdk-ext = "multimedia-layer"

require conf/distro/include/rdk_ext_lto.inc
require conf/include/rdk-bbmasks-ext.inc

BBMASK .= "${@bb.utils.contains('DISTRO_FEATURES', 'gstreamer1_18', '', "|meta-rdk-ext/recipes-devtools/orc/orc_0.4.31.bb", d)}"
BBMASK .= "${@bb.utils.contains('DISTRO_FEATURES', 'gstreamer1_18', '', "|meta-rdk-ext/recipes-multimedia/gstreamer/gstreamer1.0_1.14.1.bb", d)}"
BBMASK .= "${@bb.utils.contains('DISTRO_FEATURES', 'gstreamer1_18', '', "|meta-rdk-ext/recipes-multimedia/gstreamer/gstreamer1.0_1.14.1.bbappend", d)}"
BBMASK .= "${@bb.utils.contains('DISTRO_FEATURES', 'gstreamer1_18', '', "|meta-rdk-ext/recipes-multimedia/gstreamer/gstreamer1.0-plugins-base_1.14.1.bb", d)}"
BBMASK .= "${@bb.utils.contains('DISTRO_FEATURES', 'gstreamer1_18', '', "|meta-rdk-ext/recipes-multimedia/gstreamer/gstreamer1.0-plugins-good_1.14.1.bb", d)}"
BBMASK .= "${@bb.utils.contains('DISTRO_FEATURES', 'gstreamer1_18', '', "|meta-rdk-ext/recipes-multimedia/gstreamer/gstreamer1.0-plugins-bad_1.14.1.bb", d)}"
BBMASK .= "${@bb.utils.contains('DISTRO_FEATURES', 'gstreamer1_18', '', "|meta-rdk-ext/recipes-multimedia/gstreamer/gstreamer1.0-omx_1.14.1.bb", d)}"
BBMASK .= "${@bb.utils.contains('DISTRO_FEATURES', 'gstreamer1_18', '', "|meta-rdk-ext/recipes-multimedia/gstreamer/gstreamer1.0-libav_1.14.1.bb", d)}"

BBMASK .= "${@bb.utils.contains('DISTRO_FEATURES', 'FFmpeg_6_1_1', '', '|meta-rdk-ext/recipes-multimedia/ffmpeg/ffmpeg_6.1.1.bb', d)}"

BBMASK .= "${@bb.utils.contains('DISTRO_FEATURES', 'dunfell', '', '|meta-rdk-ext/recipes-extended/cog/cog_0.16.*', d)}"

# bbappend files to enable AddressSanitizer for some modules
BBMASK .= "${@bb.utils.contains('DISTRO_FEATURES', 'enable_asan', '', '|meta-rdk-ext/recipes-devtools/asan/*', d)}"

BBMASK .= "${@bb.utils.contains('DISTRO_FEATURES', 'googletest_1_15', '', '|recipes-test/googletest/googletest_1.15.2.bb', d)}"

BBMASK .= "${@bb.utils.contains('DISTRO_FEATURES', 'protobuf_3_19_4', '', '|meta-rdk-ext/recipes-devtools/protobuf/protobuf_3.19.4.bb', d)}"

BBMASK .= "${@bb.utils.contains('DISTRO_FEATURES', 'libwebp_1_2_4', '', '|meta-rdk-ext/recipes-extended/webp/libwebp_1.2.4.bb', d)}"

BBMASK .= "${@bb.utils.contains('DISTRO_FEATURES', 'openjpeg_2_5_0', '', '|meta-rdk-ext/recipes-graphics/openjpeg/openjpeg_2.5.0.bb', d)}"

BBMASK .= "${@bb.utils.contains('DISTRO_FEATURES', 'lua_5_4_4', '', '|meta-rdk-ext/recipes-devtools/lua/lua_5.4.4.bb', d)}"
```
